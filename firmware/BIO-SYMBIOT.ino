#define BLYNK_TEMPLATE_ID "TMPL3e8jEuavK"
#define BLYNK_TEMPLATE_NAME "BIO SYMBIOT"
#define BLYNK_AUTH_TOKEN "89Dj3rYAKdCl5G-oWrMCzGvfasDJz9sV"


#include <ESP8266WiFi.h>
#include <BlynkSimpleEsp8266.h>
#include <U8g2lib.h>
#include <Wire.h>
#include <BH1750.h>
#include <ESP8266HTTPClient.h>
#include <WiFiClient.h>


#define MOISTURE_PIN A0
#define PUMP_PIN     D5
#define AQI_PIN      D6
#define TOUCH_PIN    D7      
#define PUMP_ON  LOW
#define PUMP_OFF HIGH


U8G2_SH1106_128X64_NONAME_F_HW_I2C u8g2(U8G2_R0, U8X8_PIN_NONE);
BH1750 lightMeter;
BlynkTimer timer;


char ssid[] = "DESIRE";
char pass[] = "12345678";
const float DEEP_DARK_THRESHOLD = 20.0;
const float HAPPY_LIGHT_THRESHOLD = 300.0;
const float MAX_EXPECTED_LUX = 500.0;
const float TOO_HIGH_LIGHT_THRESHOLD = 460.0;
const int DRY_SOIL_THRESHOLD = 750;
const int WET_SOIL_THRESHOLD = 520;
const int FLOODED_SOIL_THRESHOLD = 430;


int lightPercentage = 0;
int moisturePercentage = 0;
bool isAirHealthy = true;
int globalLimbicIndex = 100;
int globalHeartRate = 72;


unsigned long drySoilTimestamp = 0;
bool dryAlertTriggered = false;
bool backupAutoPumpActive = false;
bool manualPumpOverride = false;
unsigned long autoPumpStartTimestamp = 0;
bool waitingForRecheck = false;
unsigned long recheckStartTimestamp = 0;
String localWeatherTemp = "--C";
String localWeatherDesc = "Loading...";
String tomorrowForecast = "Pending...";
unsigned long lastWeatherUpdate = 0;
const unsigned long weatherInterval = 300000; // 5 minutes


bool bootWeatherOverlayActive = false;
unsigned long bootWeatherOverlayStart = 0;
int currentDisplayMode = 0;
unsigned long lastTouchTime = 0;
int touchCount = 0;
const unsigned long doubleTapWindow = 400;
const unsigned char walk_F1[] PROGMEM = { 0x00,0x38,0x00,0x00,0x7c,0x00,0x00,0x7c,0x00,0x00,0x38,0x00,0x00,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0x00,0x00 };
const unsigned char walk_F2[] PROGMEM = { 0x00,0x38,0x00,0x00,0x7c,0x00,0x00,0x7c,0x00,0x00,0x38,0x00,0x00,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0x00,0x00 };
const unsigned char walk_F3[] PROGMEM = { 0x00,0x38,0x00,0x00,0x7c,0x00,0x00,0x7c,0x00,0x00,0x38,0x00,0x00,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0x00,0x00 };
const unsigned char walk_F4[] PROGMEM = { 0x00,0x38,0x00,0x00,0x7c,0x00,0x00,0x7c,0x00,0x00,0x38,0x00,0x00,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0x00,0x00 };
const unsigned char walk_F5[] PROGMEM = { 0x00,0x38,0x00,0x00,0x7c,0x00,0x00,0x7c,0x00,0x00,0x38,0x00,0x00,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0x00,0x00 };
const unsigned char walk_F6[] PROGMEM = { 0x00,0x38,0x00,0x00,0x7c,0x00,0x00,0x7c,0x00,0x00,0x38,0x00,0x00,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0x00,0x00 };
const unsigned char walk_F7[] PROGMEM = { 0x00,0x38,0x00,0x00,0x7c,0x00,0x00,0x7c,0x00,0x00,0x38,0x00,0x00,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0x00,0x00 };
const unsigned char walk_F8[] PROGMEM = { 0x00,0x38,0x00,0x00,0x7c,0x00,0x00,0x7c,0x00,0x00,0x38,0x00,0x00,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0x00,0x00 };
const unsigned char pain_F1[] PROGMEM = { 0x00,0x00,0x00,0x00,0x0e,0x00,0x00,0x1f,0x00,0x00,0x1f,0x00,0x00,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0x00,0x00 };
const unsigned char pain_F2[] PROGMEM = { 0x00,0x00,0x00,0x00,0x0e,0x00,0x00,0x1f,0x00,0x00,0x1f,0x00,0x00,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0x00,0x00 };
const unsigned char pain_F3[] PROGMEM = { 0x00,0x00,0x00,0x00,0x0e,0x00,0x00,0x1f,0x00,0x00,0x1f,0x00,0x00,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0x00,0x00 };
const unsigned char pain_F4[] PROGMEM = { 0x00,0x00,0x00,0x00,0x0e,0x00,0x00,0x1f,0x00,0x00,0x1f,0x00,0x00,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0x00,0x00 };
const unsigned char pain_F5[] PROGMEM = { 0x00,0x00,0x00,0x00,0x0e,0x00,0x00,0x1f,0x00,0x00,0x1f,0x00,0x00,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0x00,0x00 };
const unsigned char pain_F6[] PROGMEM = { 0x00,0x00,0x00,0x00,0x0e,0x00,0x00,0x1f,0x00,0x00,0x1f,0x00,0x00,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0x00,0x00 };
const unsigned char pain_F7[] PROGMEM = { 0x00,0x00,0x00,0x00,0x0e,0x00,0x00,0x1f,0x00,0x00,0x1f,0x00,0x00,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0x00,0x00 };
const unsigned char pain_F8[] PROGMEM = { 0x00,0x00,0x00,0x00,0x0e,0x00,0x00,0x1f,0x00,0x00,0x1f,0x00,0x00,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0x00,0x00 };


enum SystemState {
  STATE_HEALTHY,
  STATE_SOIL_BAD,
  STATE_LIGHT_BAD,
  STATE_CRITICAL,
  STATE_RECOVERING,
  STATE_WATERING,
  STATE_MANUAL_MODE,
  STATE_LIGHT_TOO_HIGH,
  STATE_SOIL_TOO_HIGH,
  STATE_BOTH_TOO_HIGH
};
SystemState currentState = STATE_HEALTHY;
SystemState previousState = STATE_HEALTHY;
bool splashActive = false;
unsigned long splashStartTime = 0;
String splashMessage = "";


const unsigned long notificationCooldown = 60000; // 60s per event code


struct EventCooldownEntry {
  const char* code;
  unsigned long lastSent;
};


EventCooldownEntry eventCooldowns[] = {
  { "light_alert",         0 },
  { "soil_alert",          0 },
  { "light_soil_critical", 0 },
  { "light_restored",      0 },
  { "soil_restored",       0 }
};
const int NUM_EVENT_CODES = sizeof(eventCooldowns) / sizeof(eventCooldowns[0]);


void showSplashMessage(const char* message) {
  splashMessage = String(message);
  splashActive = true;
  splashStartTime = millis();
}


void showStateMessage(SystemState state) {
  switch(state) {
    case STATE_HEALTHY: showSplashMessage("PLANT IS HAPPY & HEALTHY"); break;
    case STATE_SOIL_BAD: showSplashMessage("SOIL IS DRY"); break;
    case STATE_LIGHT_BAD: showSplashMessage("TOO DARK"); break;
    case STATE_CRITICAL: showSplashMessage("CRITICAL CONDITION"); break;
    case STATE_WATERING: showSplashMessage("WATERING ACTIVE"); break;
    case STATE_MANUAL_MODE: showSplashMessage("MANUAL OVERRIDE"); break;
    case STATE_LIGHT_TOO_HIGH: showSplashMessage("SCORCHING LIGHT"); break;
    case STATE_SOIL_TOO_HIGH: showSplashMessage("SOIL FLOODED"); break;
    case STATE_BOTH_TOO_HIGH: showSplashMessage("EXTREME CONDITIONS"); break;
    default: showSplashMessage("RECOVERING"); break;
  }
}


void drawSplashScreen() {
  u8g2.clearBuffer();
  u8g2.drawFrame(0, 0, 128, 64);
  u8g2.drawFrame(2, 2, 124, 60);
  u8g2.setFont(u8g2_font_6x12_tf);
  u8g2.setCursor(12, 18);
  u8g2.print("!!! ATTENTION !!!");
  u8g2.setFont(u8g2_font_6x10_tf);
  u8g2.setCursor(10, 42);
  u8g2.print(splashMessage);
  u8g2.sendBuffer();
}


void drawVisualProgressBar(int x, int y, int width, int height, int percentage, const char* label) {
  u8g2.setFont(u8g2_font_5x7_tf);
  u8g2.setCursor(x, y - 2);
  u8g2.print(label);
  u8g2.drawFrame(x, y, width, height);
  int fillWidth = map(percentage, 0, 100, 0, width - 4);
  fillWidth = constrain(fillWidth, 0, width - 4);
  u8g2.drawBox(x + 2, y + 2, fillWidth, height - 4);
  u8g2.setCursor(x + width + 4, y + height - 1);
  u8g2.print(percentage); u8g2.print("%");
}


void drawWeatherIconGraphic(int x, int y, String condition) {
  condition.toLowerCase();
  if (condition.indexOf("sun") != -1 || condition.indexOf("clear") != -1) {
    u8g2.drawCircle(x + 10, y + 10, 6);
    for (int i = 0; i < 360; i += 45) {
      float rad = i * 0.0174532925;
      int x1 = (x + 10) + cos(rad) * 8; int y1 = (y + 10) + sin(rad) * 8;
      int x2 = (x + 10) + cos(rad) * 11; int y2 = (y + 10) + sin(rad) * 11;
      u8g2.drawLine(x1, y1, x2, y2);
    }
  } else if (condition.indexOf("rain") != -1 || condition.indexOf("shower") != -1) {
    u8g2.drawDisc(x + 6, y + 10, 5); u8g2.drawDisc(x + 11, y + 7, 6); u8g2.drawDisc(x + 16, y + 10, 4);
    u8g2.drawBox(x + 6, y + 11, 11, 4);
    u8g2.drawLine(x + 6, y + 17, x + 4, y + 21); u8g2.drawLine(x + 11, y + 17, x + 9, y + 21); u8g2.drawLine(x + 16, y + 17, x + 14, y + 21);
  } else {
    u8g2.drawDisc(x + 5, y + 11, 5); u8g2.drawDisc(x + 10, y + 7, 6); u8g2.drawDisc(x + 16, y + 10, 5);
    u8g2.drawBox(x + 5, y + 11, 12, 5);
  }
}


void drawDedicatedWeatherScreen() {
  u8g2.clearBuffer();
  u8g2.drawFrame(0, 0, 128, 64);
  u8g2.drawFrame(2, 2, 124, 60);
  u8g2.setFont(u8g2_font_6x12_tf);
  u8g2.setCursor(25, 15);
  u8g2.print("WEATHER RADAR");
  u8g2.drawLine(6, 20, 122, 20);
  drawWeatherIconGraphic(10, 28, localWeatherDesc);
  u8g2.setFont(u8g2_font_5x8_tf);
  u8g2.setCursor(42, 34);
  u8g2.print("TODAY: "); u8g2.print(localWeatherTemp);
  u8g2.print("\xb0");
  u8g2.print("C");
  u8g2.setCursor(42, 44);
  u8g2.print(localWeatherDesc.substring(0, 14));
  u8g2.setCursor(42, 54);
  u8g2.print("TOMORROW: "); u8g2.print(tomorrowForecast.substring(0, 12));
  u8g2.print("\xb0");
  u8g2.print("C");
  u8g2.sendBuffer();
}


void drawClinicalECG(int xStart, int xEnd, int yCenter, int bpm) {
  int prevX = xStart;
  int prevY = yCenter;
  float speedFactor = (float)bpm / 60.0;
  unsigned long t = millis();
  for (int x = xStart; x <= xEnd; x++) {
    float phase = (x - xStart - (t * 0.04 * speedFactor));
    int p = (int)phase % 30;
    if (p < 0) p += 30;
    int yOffset = 0;
    if (p >= 2 && p <= 5) yOffset = -sin((p - 2) * 3.14159 / 3.0) * 3;
    else if (p == 7) yOffset = 2;
    else if (p == 8) yOffset = -16;
    else if (p == 9) yOffset = 5;
    else if (p >= 12 && p <= 17) yOffset = -sin((p - 12) * 3.14159 / 5.0) * 4;
    int currentY = yCenter + yOffset;
    if (x > xStart) u8g2.drawLine(prevX, prevY, x, currentY);
    prevX = x;
    prevY = currentY;
  }
}


void drawHumanLimbicDashboard(int calculatedIndex, int computedHR) {
  u8g2.setFont(u8g2_font_5x7_tf);
  u8g2.setCursor(6, 12);
  u8g2.print("LIMBIC BIOMETRICS");
  u8g2.drawLine(4, 16, 84, 16);
  u8g2.setCursor(6, 28);
  u8g2.print("INDEX: "); u8g2.print(calculatedIndex); u8g2.print("%");
  u8g2.setCursor(6, 40);
  u8g2.print("EST HR: "); u8g2.print(computedHR); u8g2.print(" BPM");
  u8g2.setCursor(6, 54);
  u8g2.print("STATE: ");
  if (calculatedIndex >= 85) u8g2.print("OPTIMAL");
  else if (calculatedIndex >= 65) u8g2.print("STABLE");
  else if (calculatedIndex >= 45) u8g2.print("STRESSED");
  else u8g2.print("CRITICAL");
  drawClinicalECG(88, 122, 34, computedHR);
}


void fetchGoogleWeatherMetrics() {
  if (WiFi.status() == WL_CONNECTED) {
    WiFiClient client;
    HTTPClient http;
    if (http.begin(client, "http://wttr.in/?format=%t|%C|%f")) {
      int httpCode = http.GET();
      if (httpCode == HTTP_CODE_OK) {
        String payload = http.getString();
        payload.trim();
        int firstPipe = payload.indexOf('|');
        int secondPipe = payload.indexOf('|', firstPipe + 1);
        if (firstPipe != -1 && secondPipe != -1) {
          localWeatherTemp = payload.substring(0, firstPipe);
          localWeatherDesc = payload.substring(firstPipe + 1, secondPipe);
          tomorrowForecast = payload.substring(secondPipe + 1);
          localWeatherTemp.replace("Â", "");
          localWeatherTemp.replace("°", "");
          localWeatherTemp.replace("C", "");
          localWeatherTemp.trim();
          tomorrowForecast.replace("Â", "");
          tomorrowForecast.replace("°", "");
          tomorrowForecast.replace("C", "");
          tomorrowForecast.trim();
        }
      }
      http.end();
    }
  }
}


void runCuriousBootAnimation() {
  int centerLeftX = 26;
  int centerRightX = 78;
  int eyeY = 16;
  int boxW = 24;
  int boxH = 24;
  int radius = 4;
  u8g2.clearBuffer();
  u8g2.setFont(u8g2_font_6x12_tf);
  u8g2.drawStr(12, 36, "Booting the system...");
  u8g2.sendBuffer();
  delay(2000);
  u8g2.clearBuffer();
  u8g2.setFont(u8g2_font_7x14_tf);
  u8g2.drawStr(4, 36, "How's the weather?");
  u8g2.sendBuffer();
  delay(1500);
  int pupilOffsetsX[] = { 0, -4, 4, 0 };
  for(int loopIndex = 0; loopIndex < 2; loopIndex++) {
    for (int step = 0; step < 4; step++) {
      u8g2.clearBuffer();
      u8g2.drawRBox(centerLeftX + pupilOffsetsX[step], eyeY, boxW, boxH, radius);
      u8g2.drawRBox(centerRightX + pupilOffsetsX[step], eyeY, boxW, boxH, radius);
      u8g2.setFont(u8g2_font_5x8_tf);
      u8g2.drawStr(36, 56, "SEARCHING...");
      u8g2.sendBuffer();
      delay(600);
    }
    u8g2.clearBuffer();
    u8g2.drawRBox(centerLeftX, eyeY + 10, boxW, 4, 1);
    u8g2.drawRBox(centerRightX, eyeY + 10, boxW, 4, 1);
    u8g2.sendBuffer();
    delay(200);
  }
  u8g2.clearBuffer();
  u8g2.drawRBox(centerLeftX - 2, eyeY - 2, 28, 28, radius + 1);
  u8g2.drawRBox(centerRightX - 2, eyeY - 2, 28, 28, radius + 1);
  u8g2.sendBuffer();
  delay(500);
  u8g2.clearBuffer();
  u8g2.drawRBox(centerLeftX - 2, eyeY - 2, 28, 28, radius + 1);
  u8g2.drawRBox(centerRightX - 3, eyeY + 10, 30, 6, 1);
  u8g2.sendBuffer();
  delay(350);
  u8g2.clearBuffer();
  u8g2.drawRBox(centerLeftX - 2, eyeY - 2, 28, 28, radius + 1);
  u8g2.drawRBox(centerRightX - 2, eyeY - 2, 28, 28, radius + 1);
  u8g2.setFont(u8g2_font_6x10_tf);
  u8g2.drawStr(43, 56, "GOT IT!");
  u8g2.sendBuffer();
  delay(1500);
  bootWeatherOverlayActive = true;
  bootWeatherOverlayStart = millis();
}


void sendEvent(const char* eventName, const String &message) {
  for (int i = 0; i < NUM_EVENT_CODES; i++) {
    if (strcmp(eventCooldowns[i].code, eventName) == 0) {
      if (millis() - eventCooldowns[i].lastSent > notificationCooldown || eventCooldowns[i].lastSent == 0) {
        if (Blynk.connected()) {
          Blynk.logEvent(eventName, message);
          eventCooldowns[i].lastSent = millis();
          Serial.print("Blynk event sent: ");
          Serial.println(eventName);
        }
      }
      return;
    }
  }
  
  if (Blynk.connected()) {
    Blynk.logEvent(eventName, message);
  }
}


void handleStateNotifications(SystemState newState, SystemState oldState) {
  switch (newState) {
    case STATE_LIGHT_BAD:
      sendEvent("light_alert", "Plant status: Dramatic wilting risk - light too low");
      break;
    case STATE_SOIL_BAD:
      sendEvent("soil_alert", "Plant status: Dramatic wilting risk - soil too dry");
      break;
    case STATE_CRITICAL:
      sendEvent("light_soil_critical", "Plant status: Dramatic wilting risk - critical (dark + dry)");
      break;
    default:
      break;
  }


  bool wasLightBad = (oldState == STATE_LIGHT_BAD || oldState == STATE_CRITICAL);
  bool isLightBadNow = (newState == STATE_LIGHT_BAD || newState == STATE_CRITICAL);
  if (wasLightBad && !isLightBadNow) {
    sendEvent("light_restored", "Light conditions returned to normal");
  }


  bool wasSoilBad = (oldState == STATE_SOIL_BAD || oldState == STATE_CRITICAL);
  bool isSoilBadNow = (newState == STATE_SOIL_BAD || newState == STATE_CRITICAL);
  if (wasSoilBad && !isSoilBadNow) {
    sendEvent("soil_restored", "Soil moisture returned to healthy range");
  }
}


void drawFearFace() {
  u8g2.drawCircle(96, 36, 16, U8G2_DRAW_ALL);
  u8g2.drawLine(84, 25, 90, 22); u8g2.drawLine(108, 25, 102, 22);
  u8g2.drawCircle(88, 30, 3); u8g2.drawCircle(104, 30, 3);
  u8g2.drawBox(92, 44, 8, 4);
}


void drawJoyousFace() {
  u8g2.drawCircle(96, 36, 16, U8G2_DRAW_ALL);
  u8g2.drawCircle(88, 34, 4, U8G2_DRAW_UPPER_LEFT | U8G2_DRAW_UPPER_RIGHT);
  u8g2.drawCircle(104, 34, 4, U8G2_DRAW_UPPER_LEFT | U8G2_DRAW_UPPER_RIGHT);
  u8g2.drawCircle(96, 34, 10, U8G2_DRAW_LOWER_LEFT | U8G2_DRAW_LOWER_RIGHT);
  u8g2.drawLine(86, 34, 106, 34);
}


void drawThirstyFace() {
  u8g2.drawCircle(96, 36, 16, U8G2_DRAW_ALL);
  u8g2.drawLine(84, 22, 90, 25); u8g2.drawLine(108, 22, 102, 25);
  u8g2.drawDisc(88, 30, 2); u8g2.drawDisc(104, 30, 2);
  u8g2.drawCircle(96, 48, 6, U8G2_DRAW_UPPER_LEFT | U8G2_DRAW_UPPER_RIGHT);
}


void drawSleepingFace() {
  u8g2.drawCircle(96, 32, 20, U8G2_DRAW_ALL);
  u8g2.drawCircle(88, 28, 3, U8G2_DRAW_LOWER_LEFT | U8G2_DRAW_LOWER_RIGHT);
  u8g2.drawCircle(104, 28, 3, U8G2_DRAW_LOWER_LEFT | U8G2_DRAW_LOWER_RIGHT);
  u8g2.drawCircle(96, 40, 3, U8G2_DRAW_ALL);
  u8g2.setFont(u8g2_font_5x7_tf); u8g2.drawStr(104, 18, "z");
  u8g2.setFont(u8g2_font_6x10_tf); u8g2.drawStr(111, 13, "Z");
  u8g2.setFont(u8g2_font_7x14_tf); u8g2.drawStr(118, 10, "Z");
}


void drawNeutralFace() {
  u8g2.drawCircle(96, 36, 16, U8G2_DRAW_ALL);
  u8g2.drawDisc(88, 30, 2); u8g2.drawDisc(104, 30, 2);
  u8g2.drawLine(86, 44, 106, 44);
}


void drawWateringFace() {
  u8g2.drawCircle(96, 36, 16, U8G2_DRAW_ALL);
  u8g2.drawDisc(88, 28, 3); u8g2.drawDisc(104, 28, 3);
  u8g2.drawCircle(96, 36, 8, U8G2_DRAW_LOWER_LEFT | U8G2_DRAW_LOWER_RIGHT);
  u8g2.drawLine(88, 36, 104, 36);
  if ((millis() / 250) % 2 == 0) {
    u8g2.drawPixel(75, 45); u8g2.drawPixel(115, 45);
  } else {
    u8g2.drawPixel(73, 50); u8g2.drawPixel(117, 50);
  }
}


void drawManualFace() {
  u8g2.drawCircle(96, 36, 16, U8G2_DRAW_ALL);
  u8g2.drawBox(82, 26, 13, 6); u8g2.drawBox(97, 26, 13, 6);
  u8g2.drawLine(95, 28, 97, 28);
  u8g2.drawCircle(96, 42, 4, U8G2_DRAW_LOWER_LEFT | U8G2_DRAW_LOWER_RIGHT);
}


void drawFaceForState() {
  switch(currentState) {
    case STATE_HEALTHY: drawJoyousFace(); break;
    case STATE_SOIL_BAD: drawThirstyFace(); break;
    case STATE_LIGHT_BAD: drawSleepingFace(); break;
    case STATE_CRITICAL: drawFearFace(); break;
    case STATE_RECOVERING: drawNeutralFace(); break;
    case STATE_WATERING: drawWateringFace(); break;
    case STATE_MANUAL_MODE: drawManualFace(); break;
    case STATE_LIGHT_TOO_HIGH: drawFearFace(); break;
    case STATE_SOIL_TOO_HIGH: drawThirstyFace(); break;
    case STATE_BOTH_TOO_HIGH: drawFearFace(); break;
    default: drawNeutralFace(); break;
  }
}


BLYNK_WRITE(V1) {
  if (param.asInt() == 1) {
    currentState = STATE_HEALTHY; previousState = STATE_HEALTHY;
    splashActive = false; backupAutoPumpActive = false;
    dryAlertTriggered = false; manualPumpOverride = false;
    waitingForRecheck = false; bootWeatherOverlayActive = false;
    currentDisplayMode = 0;
    digitalWrite(PUMP_PIN, PUMP_OFF); Blynk.virtualWrite(V7, 0);
    u8g2.begin();
  }
}


BLYNK_WRITE(V7) {
  int switchState = param.asInt();
  if (switchState == 1) {
    manualPumpOverride = true; backupAutoPumpActive = false; waitingForRecheck = false;
    digitalWrite(PUMP_PIN, PUMP_ON); showSplashMessage("MANUAL OVERRIDE");
  } else {
    manualPumpOverride = false; digitalWrite(PUMP_PIN, PUMP_OFF);
  }
}


BLYNK_WRITE(V8) {
  currentDisplayMode = param.asInt();
}


void handleTouchInput() {
  static int lastTouchState = LOW;
  int currentTouch = digitalRead(TOUCH_PIN);


  if (currentTouch == HIGH && lastTouchState == LOW) {  // Rising edge = new tap
    unsigned long now = millis();


    if ((now - lastTouchTime) < doubleTapWindow) {
      
      touchCount = 2;
      Serial.println("Double Tap Detected!");
      if (currentDisplayMode == 0) {
        currentDisplayMode = 2;
      } else {
        currentDisplayMode = 0;
      }
    } else {
      touchCount = 1;
      Serial.println("Single Tap Registered (waiting for possible double)");
    }
    
    lastTouchTime = now;
  }


  lastTouchState = currentTouch;


  static unsigned long singleTapCheckTime = 0;
  if (touchCount == 1 && millis() - lastTouchTime > doubleTapWindow) {
    Serial.println("Single Tap Confirmed → Limbic Toggle");
    
    if (currentDisplayMode == 0) {
      currentDisplayMode = 1;
    } else if (currentDisplayMode == 1) {
      currentDisplayMode = 0;
    } else {
      currentDisplayMode = 1;
    }
    
    touchCount = 0;
  }
}
void runInteractiveStateCore() {
  ESP.wdtFeed();
  float lux = lightMeter.readLightLevel();
  if (isnan(lux) || lux < 0) lux = 0;
  int rawMoisture = analogRead(MOISTURE_PIN);
  isAirHealthy = (digitalRead(AQI_PIN) == HIGH);
  lightPercentage = constrain(map((int)lux, 0, (int)MAX_EXPECTED_LUX, 0, 100), 0, 100);
  const int SENSOR_DRY = 1024;
  const int SENSOR_WATER = 400;
  moisturePercentage = constrain(map(rawMoisture, SENSOR_DRY, SENSOR_WATER, 0, 100), 0, 100);
  if(rawMoisture <= 430) moisturePercentage = 100;


  bool isDark = (lux < DEEP_DARK_THRESHOLD);
  bool isDry = (rawMoisture > DRY_SOIL_THRESHOLD);
  bool isLightHealthy = (lightPercentage >= 30 && lightPercentage < 100);
  bool isMoistureHealthy = (rawMoisture <= WET_SOIL_THRESHOLD && rawMoisture >= FLOODED_SOIL_THRESHOLD);
  bool isLightTooHigh = (lux >= TOO_HIGH_LIGHT_THRESHOLD);
  bool isMoistureTooHigh = (rawMoisture < FLOODED_SOIL_THRESHOLD);


  if (manualPumpOverride) {
    digitalWrite(PUMP_PIN, PUMP_ON); dryAlertTriggered = false; backupAutoPumpActive = false; waitingForRecheck = false;
  } else {
    if (waitingForRecheck) {
      digitalWrite(PUMP_PIN, PUMP_OFF);
      if (millis() - recheckStartTimestamp >= 300000) {
        waitingForRecheck = false;
        if (analogRead(MOISTURE_PIN) > DRY_SOIL_THRESHOLD) {
          backupAutoPumpActive = true; autoPumpStartTimestamp = millis();
          digitalWrite(PUMP_PIN, PUMP_ON); showSplashMessage("RE-CHECK: AUTO ON");
        } else {
          dryAlertTriggered = false; showSplashMessage("SOIL RECOVERED");
        }
      }
    }
    else if (backupAutoPumpActive) {
      digitalWrite(PUMP_PIN, PUMP_ON);
      if (millis() - autoPumpStartTimestamp >= 30000) {
        digitalWrite(PUMP_PIN, PUMP_OFF); backupAutoPumpActive = false;
        waitingForRecheck = true; recheckStartTimestamp = millis();
        showSplashMessage("AUTO OFF: WAITING");
      }
    }
    else {
      if (isDry) {
        if (!dryAlertTriggered) {
          drySoilTimestamp = millis(); dryAlertTriggered = true;
          showSplashMessage("TURN ON PUMP!");
        } else {
          if (millis() - drySoilTimestamp >= 60000) {
            backupAutoPumpActive = true; autoPumpStartTimestamp = millis();
            digitalWrite(PUMP_PIN, PUMP_ON); showSplashMessage("TIMEOUT: AUTO ON");
          }
        }
      } else {
        dryAlertTriggered = false;
      }
    }
  }


  previousState = currentState;
  if (manualPumpOverride) currentState = STATE_MANUAL_MODE;
  else if (backupAutoPumpActive) currentState = STATE_WATERING;
  else if (isLightTooHigh && isMoistureTooHigh) currentState = STATE_BOTH_TOO_HIGH;
  else if (isLightTooHigh) currentState = STATE_LIGHT_TOO_HIGH;
  else if (isMoistureTooHigh) currentState = STATE_SOIL_TOO_HIGH;
  else if (isDark && isDry) currentState = STATE_CRITICAL;
  else if (isDark) currentState = STATE_LIGHT_BAD;
  else if (isDry) currentState = STATE_SOIL_BAD;
  else if (isLightHealthy && isMoistureHealthy) currentState = STATE_HEALTHY;
  else currentState = STATE_RECOVERING;


  if (currentState != previousState) {
    showStateMessage(currentState);
    handleStateNotifications(currentState, previousState);
  }


  if (Blynk.connected()) {
    Blynk.virtualWrite(V0, lux);
    Blynk.virtualWrite(V2, lightPercentage); Blynk.virtualWrite(V3, rawMoisture);
    Blynk.virtualWrite(V4, moisturePercentage); Blynk.virtualWrite(V5, lux);
  }


  int runningScore = 100;
  if (!isMoistureHealthy) runningScore -= 25;
  if (!isLightHealthy) runningScore -= 15;
  if (!isAirHealthy) runningScore -= 20;
  int internalTemp = localWeatherTemp.toInt();
  if (internalTemp > 38 || internalTemp < 12) runningScore -= 15;
  globalLimbicIndex = constrain(runningScore, 15, 100);
  globalHeartRate = map(globalLimbicIndex, 100, 15, 66, 138);
  static int moistureAvg = 50;
  static int lightAvg = 50;
  static bool firstTelemetry = true;
  
  if (firstTelemetry) {
    moistureAvg = moisturePercentage;
    lightAvg = lightPercentage;
    firstTelemetry = false;
  } else {
    moistureAvg = 0.65 * moistureAvg + 0.35 * moisturePercentage;
    lightAvg = 0.65 * lightAvg + 0.35 * lightPercentage;
  }


  moistureAvg = constrain(moistureAvg, 0, 100);
  lightAvg = constrain(lightAvg, 0, 100);


  Serial.print("Moisture_Percent:"); Serial.print(moistureAvg);
  Serial.print(" Light_Percent:");   Serial.print(lightAvg);
  Serial.print(" State_Index:");     Serial.println(currentState);
  Serial.print(" Raw_D6_Read:");     Serial.println(digitalRead(AQI_PIN));
}


void refreshSystemDisplay() {
  if (bootWeatherOverlayActive) {
    if (millis() - bootWeatherOverlayStart < 15000) {
      drawDedicatedWeatherScreen();
      return;
    } else {
      bootWeatherOverlayActive = false;
    }
  }
  if (splashActive) {
    drawSplashScreen();
    if (millis() - splashStartTime > 2000) splashActive = false;
    return;
  }


  u8g2.clearBuffer();
  if (currentDisplayMode == 1) {
    u8g2.drawFrame(0, 0, 128, 64);
    drawHumanLimbicDashboard(globalLimbicIndex, globalHeartRate);
  } else if (currentDisplayMode == 2) {
    drawDedicatedWeatherScreen();
  } else {
    drawVisualProgressBar(0, 9, 48, 8, lightPercentage, "LIGHT");
    drawVisualProgressBar(0, 27, 48, 8, moisturePercentage, "SOIL");
    u8g2.setFont(u8g2_font_5x7_tf);
    u8g2.setCursor(0, 44);
    u8g2.print("WTH: ");
    u8g2.print(localWeatherTemp);
    u8g2.print("\xb0");
    u8g2.print("C");
    u8g2.setCursor(0, 52);
    u8g2.print(localWeatherDesc.substring(0, 14));
    u8g2.setCursor(0, 62);
    u8g2.print("AIR: "); u8g2.print(isAirHealthy ? "GD " : "PR ");
    u8g2.print(Blynk.connected() ? (manualPumpOverride ? "| MAN" : "| ONL") : "| OFL");
    drawFaceForState();
  }
  u8g2.sendBuffer();
}


void setup() {
  Serial.begin(115200);
  delay(500);
  pinMode(MOISTURE_PIN, INPUT);
  pinMode(PUMP_PIN, OUTPUT);
  pinMode(AQI_PIN, INPUT);
  pinMode(TOUCH_PIN, INPUT);
  digitalWrite(PUMP_PIN, PUMP_OFF);
  Wire.begin(D2, D1);
  lightMeter.begin(BH1750::CONTINUOUS_HIGH_RES_MODE);
  u8g2.begin();
  WiFi.begin(ssid, pass);
  int connectTimeout = 0;
  while (WiFi.status() != WL_CONNECTED && connectTimeout < 20) { delay(500); connectTimeout++; }
  fetchGoogleWeatherMetrics();
  lastWeatherUpdate = millis();
  runCuriousBootAnimation();
  Blynk.begin(BLYNK_AUTH_TOKEN, ssid, pass);
  timer.setInterval(1000L, runInteractiveStateCore);
}
void loop() {
  if (WiFi.status() != WL_CONNECTED) WiFi.begin(ssid, pass);
  Blynk.run();
  timer.run();


  if (millis() - lastWeatherUpdate >= weatherInterval) {
    fetchGoogleWeatherMetrics();
    lastWeatherUpdate = millis();
  }


  handleTouchInput();


  static unsigned long lastDisplay = 0;
  if (millis() - lastDisplay >= 33) {
    refreshSystemDisplay();
    lastDisplay = millis();
  }
}
